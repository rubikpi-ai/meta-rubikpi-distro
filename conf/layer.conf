## conf/layer.conf
```bitbake
# We have a conf and classes directory, add to BBPATH
BBPATH .= ":${LAYERDIR}"

# We have a packages directory, add to BBFILES
BBFILES += "${LAYERDIR}/recipes-*/*/*.bb \
            ${LAYERDIR}/recipes-*/*/*.bbappend"

BBFILE_COLLECTIONS        += "rubikpi-distro"
BBFILE_PATTERN_rubikpi-distro := "^${LAYERDIR}/"
BBFILE_PRIORITY_rubikpi-distro = "10"

LAYERDEPENDS_rubikpi-distro = "rubikpi-bsp"
LAYERSERIES_COMPAT_rubikpi-distro = "scarthgap"
```
